## init/Kconfig.suse
```kconfig
config SUSE_KERNEL
	def_bool y

menu "SUSE Release Details"
choice SUSE_PRODUCT_CODE
	prompt "SUSE Product Family"
	default SUSE_PRODUCT_EULER
	depends on SUSE_KERNEL
	help
	  This option defines the SUSE product family that owns this
	  kernel release.

config SUSE_PRODUCT_EULER
	bool "SUSE Euler Linux"
endchoice

config SUSE_PRODUCT_CODE
	int
	default 1 if SUSE_PRODUCT_EULER

if SUSE_PRODUCT_EULER
config SUSE_VERSION
	int "Release Version"
	range 0 255
	default 2

config SUSE_PATCHLEVEL
	int "Service Pack Version"
	range 0 255
	default 0
endif

config SUSE_AUXRELEASE
	int
	range 0 255
	default 0

config SUSE_KERNEL_SUPPORTED
	bool "Enable enterprise support facility"
	depends on SUSE_KERNEL
	help
	  This feature enables the handling of the "supported" module flag.
	  This flag can be used to report unsupported module loads or even
	  refuse them entirely. It is useful when ensuring that the kernel
	  remains in a state that SUSE, or its technical partners, is
	  prepared to support.

	  Modules in the list of supported modules will be marked supported
	  on build. The default enforcement mode is to report, but not
	  deny, loading of unsupported modules.

	  If you aren't building a kernel for an enterprise distribution,
	  say n.

config SUSE_KERNEL_RELEASED
	bool "Release kernel"
	default n
	help
	  This kernel is built for release through official channels.

endmenu
```
